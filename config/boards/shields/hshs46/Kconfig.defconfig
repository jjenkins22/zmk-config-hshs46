## config/boards/shields/hshs46/Kconfig.defconfig
```kconfig
# Copyright (c) 2021-2022 The ZMK Contributors
# SPDX-License-Identifier: MIT

if SHIELD_HSHS46_LEFT || SHIELD_HSHS46_RIGHT || SHIELD_HSHS46_DONGLE

config ZMK_KEYBOARD_NAME
    default "HSHS46"

config ZMK_SPLIT
    default y

endif

if SHIELD_HSHS46_DONGLE

config ZMK_SPLIT_ROLE_CENTRAL
    default y

endif
```

## config/west.yml
```yaml
manifest:
  remotes:
    - name: zmkfirmware
      url-base: https://github.com/zmkfirmware
  projects:
    - name: zmk
      remote: zmkfirmware
      revision: db4db6f
      import: app/west.yml
  self:
    path: config
```
