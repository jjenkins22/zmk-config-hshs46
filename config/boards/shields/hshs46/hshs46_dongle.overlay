/*
 * Copyright (c) 2021-2022 The ZMK Contributors
 *
 * SPDX-License-Identifier: MIT
 */

/ {
    chosen {
        zmk,kscan = &kscan0;
    };

    kscan0: kscan0 {
        compatible = "zmk,kscan-mock";
        exit-after;
    };
};
